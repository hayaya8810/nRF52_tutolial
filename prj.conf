## CMakeLists.txt
```
# SPDX-License-Identifier: Apache-2.0

cmake_minimum_required(VERSION 3.20.0)
find_package(Zephyr REQUIRED HINTS $ENV{ZEPHYR_BASE})
project(blinky)

target_sources(app PRIVATE
	src/main.c
	src/led.c
	src/button.c
	src/nus.c
	src/app.c
)
```

## prj.conf
```kconfig
CONFIG_GPIO=y

CONFIG_BT=y
CONFIG_BT_PERIPHERAL=y
CONFIG_BT_DEVICE_NAME="Blinky_NUS"
CONFIG_BT_MAX_CONN=1
CONFIG_BT_NUS=y

CONFIG_DEBUG=y
CONFIG_DEBUG_OPTIMIZATIONS=y
CONFIG_DEBUG_THREAD_INFO=y
```

## src/main.c
```c
/**
******************************************************************************
* @file				: main.c
* @brief			: main program for LED blink
******************************************************************************
* @attention
*
* Copyright (c) 2026 hayaya inc.
* All rights reserved.
*
* This software is licensed under terms that can be found in the LICENSE file
* in the root directory of this software component.
* If no LICENSE file comes with this software, it is provided AS-IS.
*
******************************************************************************
*/
/* Includes ------------------------------------------------------------------*/
#include <stdio.h>
#include <zephyr/kernel.h>
#include <zephyr/drivers/gpio.h>

/* Private includes ----------------------------------------------------------*/
#include "button.h"
#include "led.h"
#include "nus.h"
#include "app.h"

/* Private define ------------------------------------------------------------*/

/* Private typedef -----------------------------------------------------------*/

/* Private macro -------------------------------------------------------------*/

/* Private variables ---------------------------------------------------------*/

/* Private function prototypes -----------------------------------------------*/
static void button_handler(BUTTON_ID id, BUTTON_EVENT event);
static void nus_led_control_callback(uint32_t led_mask);

/* External variables --------------------------------------------------------*/

/* Exported functions --------------------------------------------------------*/
/**
 * @brief		Main function
*/
int main(void)
{
	int ret;
	ret = button_init();
	if (ret < 0) {
		printf("Failed to initialize buttons\n");
		return -1;
	}
	ret = led_init();
	if (ret < 0) {
		printf("Failed to initialize LEDs\n");
		return -1;
	}
	ret = nus_init();
	if (ret < 0) {
		printf("Failed to initialize NUS\n");
		return -1;
	}

	for( size_t i = 0; i < BUTTON_ID_COUNT; i++) {
		ret = button_register_callback((BUTTON_ID)i, button_handler);
		if (ret < 0) {
			printf("Failed to register button callback for button %zu\n", i);
			return -1;
		}
	}

	ret = nus_register_led_control_callback(nus_led_control_callback);
	if (ret < 0) {
		printf("Failed to register NUS LED control callback\n");
		return -1;
	}

	while (1) {
		APP_EVENT event;
		if (app_event_get(&event) == 0) {
			app_handle_event(&event);
		}
	}
	return 0;
}

/* Private user code ---------------------------------------------------------*/
/**
 * @brief		Button event handler to toggle corresponding LED on button press
 * @param[in]	id			Button identifier
 * @param[in]	event		Button event type (pressed or released)
 */
static void button_handler(BUTTON_ID id, BUTTON_EVENT event)
{
	uint32_t led_mask = 0x00;

	if (event == BUTTON_EVENT_PRESSED) {
		switch (id){
		case BUTTON_ID_0:
			led_mask = 0x01;	// Mask for LED_ID_0
			nus_notify_led_event((LED_ID)id);
			break;
		case BUTTON_ID_1:
			led_mask = 0x02;	// Mask for LED_ID_1
			nus_notify_led_event((LED_ID)id);
			break;
		case BUTTON_ID_2:
			led_mask = 0x04;	// Mask for LED_ID_2
			nus_notify_led_event((LED_ID)id);
			break;
		case BUTTON_ID_3:
			led_mask = 0x08;	// Mask for LED_ID_3
			nus_notify_led_event((LED_ID)id);
			break;
		default:
			break;
		}
		app_event_submit(APP_EVENT_TYPE_LED_TOGGLE, led_mask);
	}
}

/**
 * @brief		Callback function for controlling LEDs from BLE commands
 * @param[in]	led_mask	Bitmask indicating which LEDs to toggle (1 = toggle, 0 = no change)
 */
static void nus_led_control_callback(uint32_t led_mask)
{
	app_event_submit(APP_EVENT_TYPE_LED_TOGGLE, led_mask);
}
```

## src/app.c
```c
/**
******************************************************************************
* @file				: app.c
* @brief			: Application functions.
******************************************************************************
* @attention
*
* Copyright (c) 2026 hayaya inc.
* All rights reserved.
*
* This software is licensed under terms that can be found in the LICENSE file
* in the root directory of this software component.
* If no LICENSE file comes with this software, it is provided AS-IS.
*
******************************************************************************
*/
/* Includes ------------------------------------------------------------------*/
#include <stdio.h>
#include <zephyr/kernel.h>
#include <zephyr/sys/util.h>

/* Private includes ----------------------------------------------------------*/
#include "app.h"
#include "led.h"
#include "nus.h"

/* Private define ------------------------------------------------------------*/
#define APP_EVENT_QUEUE_SIZE		10

/* Private typedef -----------------------------------------------------------*/

/* Private macro -------------------------------------------------------------*/

/* Private variables ---------------------------------------------------------*/
K_MSGQ_DEFINE(m_event_queue, sizeof(APP_EVENT), APP_EVENT_QUEUE_SIZE, 4);

/* Private function prototypes -----------------------------------------------*/
static int app_toggle_leds(uint32_t led_mask);

/* External variables --------------------------------------------------------*/

/* Exported functions --------------------------------------------------------*/
/**
 * @brief		Get the next application event from the event queue
 * @param[out]	event		Pointer to store the retrieved event
 * @return		0			success
 * 				negative	error code on failure
 */
int app_event_get(APP_EVENT *event)
{
	if (event == NULL) {
		return -1;				// Invalid argument
	}

	return k_msgq_get(&m_event_queue, event, K_FOREVER);
}

/**
 * @brief		Handle an application event
 * @param[in]	event		Pointer to the event to handle
 * @return		0			success
 * 				negative	error code on failure (e.g., unknown event type)
 */
int app_handle_event(const APP_EVENT *event)
{
	if (event == NULL) {
		return -1;				// Invalid argument
	}

	switch (event->type) {
	case APP_EVENT_TYPE_LED_TOGGLE:
		app_toggle_leds(event->led_mask);
		printf("Handling LED toggle event, led_mask=0x%08X\n", event->led_mask);
		break;
	default:
		return -1;				// Unknown event type
	}

	return 0;
}

int app_event_submit(APP_EVENT_TYPE type, uint32_t led_mask)
{
	APP_EVENT event = {
		.type = type,
		.led_mask = led_mask,
	};

	return k_msgq_put(&m_event_queue, &event, K_NO_WAIT);
}

/* Private user code ---------------------------------------------------------*/
/**
 * @brief		Toggle LEDs based on the provided bitmask
 * @param[in]	led_mask	Bitmask indicating which LEDs to toggle (1 = toggle, 0 = no change)
 * @return		0			success
 * 				negative	error code on failure
 */
static int app_toggle_leds(uint32_t led_mask)
{
	int ret = -1;

	if( BIT(LED_ID_0) & led_mask) {
		ret = led_blink_toggle(LED_ID_0, 500, 500);
		nus_notify_led_event(LED_ID_0);
	}
	if (BIT(LED_ID_1) & led_mask) {
		ret = led_blink_toggle(LED_ID_1, 250, 250);
		nus_notify_led_event(LED_ID_1);
	}
	if (BIT(LED_ID_2) & led_mask) {
		ret = led_blink_toggle(LED_ID_2, 125, 125);
		nus_notify_led_event(LED_ID_2);
	}
	if (BIT(LED_ID_3) & led_mask) {
		ret = led_toggle(LED_ID_3);
		nus_notify_led_event(LED_ID_3);
	}
	return ret;
}
```

## src/app.h
```c
/**
******************************************************************************
* @file				: app.h
* @brief			: Header for app.c file.
******************************************************************************
* @attention
*
* Copyright (c) 2026 hayaya inc.
* All rights reserved.
*
* This software is licensed under terms that can be found in the LICENSE file
* in the root directory of this software component.
* If no LICENSE file comes with this software, it is provided AS-IS.
*
******************************************************************************
*/

/* Define to prevent recursive inclusion -------------------------------------*/
#ifndef APP_H
#define APP_H

#ifdef __cplusplus
extern "C" {
#endif

/* Includes ------------------------------------------------------------------*/
#include <stdint.h>

/* Private includes ----------------------------------------------------------*/

/* Private defines -----------------------------------------------------------*/

/* Exported constants --------------------------------------------------------*/

/* Exported macro ------------------------------------------------------------*/

/* Exported types ------------------------------------------------------------*/
/**
 * @brief Application event types
 */
typedef enum __APP_EVENT_TYPE {
	APP_EVENT_TYPE_LED_TOGGLE,		// Event type for LED toggle events
} APP_EVENT_TYPE;

/**
 * @brief Application event structure
 */
typedef struct __APP_EVENT {
	APP_EVENT_TYPE type;				// Type of the event
	uint32_t led_mask;					// For LED toggle events, the mask of LEDs that changed
} APP_EVENT;

/* Exported functions prototypes ---------------------------------------------*/
int app_event_get(APP_EVENT *event);
int app_handle_event(const APP_EVENT *event);
int app_event_submit(APP_EVENT_TYPE type, uint32_t led_mask);

#ifdef __cplusplus
}
#endif

#endif  // APP_H
```

## src/button.c
```c
/**
******************************************************************************
* @file				: button.c
* @brief			: Button driver.
******************************************************************************
* @attention
*
* Copyright (c) 2026 hayaya inc.
* All rights reserved.
*
* This software is licensed under terms that can be found in the LICENSE file
* in the root directory of this software component.
* If no LICENSE file comes with this software, it is provided AS-IS.
*
******************************************************************************
*/
/* Includes ------------------------------------------------------------------*/
#include <zephyr/drivers/gpio.h>

/* Private includes ----------------------------------------------------------*/
#include "button.h"

/* Private define ------------------------------------------------------------*/
#define BUTTON_DEBOUNE_MS		50			// Debounce time in milliseconds
#define BUTTON0_NODE DT_ALIAS(sw0)
#define BUTTON1_NODE DT_ALIAS(sw1)
#define BUTTON2_NODE DT_ALIAS(sw2)
#define BUTTON3_NODE DT_ALIAS(sw3)

/* Private typedef -----------------------------------------------------------*/
/**
 * @brief Button context structure for debouncing and event handling
 */
typedef struct __BUTTON_CONTEXT {
	struct gpio_callback gpio_cb;			// GPIO callback structure for button interrupts
	struct k_work_delayable debounce_work;	// Delayed work for debouncing
	BUTTON_STATE stable_state;				// Stable state of the button after debouncing
	button_callback_t callback;				// User callback function for button events
} BUTTON_CONTEXT;

/* Private macro -------------------------------------------------------------*/

/* Private variables ---------------------------------------------------------*/
/**
 * @brief GPIO specifications for each button, obtained from device tree
 */
static const struct gpio_dt_spec m_buttons[] = {
	GPIO_DT_SPEC_GET(BUTTON0_NODE, gpios),
	GPIO_DT_SPEC_GET(BUTTON1_NODE, gpios),
	GPIO_DT_SPEC_GET(BUTTON2_NODE, gpios),
	GPIO_DT_SPEC_GET(BUTTON3_NODE, gpios),
};

/**
 * @brief Button contexts for each button, used for debouncing and event handling
 */
static BUTTON_CONTEXT m_button_contexts[BUTTON_ID_COUNT];

/* Private function prototypes -----------------------------------------------*/
static void button_gpio_isr(const struct device *dev, struct gpio_callback *cb, uint32_t pins);
static void button_debounce_work_handler(struct k_work *work);

/* External variables --------------------------------------------------------*/

/* Exported functions --------------------------------------------------------*/
/**
 * @brief		Initialize the buttons
 * @return		0			success
 * 				negative	error code on failure
 */
int button_init(void)
{
	for (size_t i = 0; i < BUTTON_ID_COUNT; i++) {
		// Configure button GPIO as input with pull-up and set up interrupt for both edges
		if (!device_is_ready(m_buttons[i].port)) {
			return -1;
		}

		// Configure GPIO pin as input with pull-up resistor
		int ret = gpio_pin_configure_dt(&m_buttons[i], GPIO_INPUT | GPIO_PULL_UP);
		if (ret < 0) {
			return -1;
		}

		// Initialize GPIO callback for button interrupts
		gpio_init_callback(&m_button_contexts[i].gpio_cb, button_gpio_isr, BIT(m_buttons[i].pin));
		ret = gpio_add_callback(m_buttons[i].port, &m_button_contexts[i].gpio_cb);
		if (ret < 0) {
			return -1;
		}

		// Configure GPIO interrupt for both rising and falling edges
		ret = gpio_pin_interrupt_configure_dt(&m_buttons[i], GPIO_INT_EDGE_BOTH);
		if (ret < 0) {
			return -1;
		}

		// Initialize debounce work for the button context
		m_button_contexts[i].stable_state = BUTTON_STATE_RELEASED;
		m_button_contexts[i].callback = NULL;
		k_work_init_delayable(&m_button_contexts[i].debounce_work, button_debounce_work_handler);
	}
	return 0;
}

/**
 * @brief		Get the current state of a button
 * @param[in]	id			Button identifier
 * @param[out]	state		Current button state
 * @return		0			success
 * 				negative	error code on failure
 */
int button_get(BUTTON_ID id, BUTTON_STATE *state)
{
	if (id >= BUTTON_ID_COUNT || state == NULL) {
		return -1;			// Invalid argument
	}

	int val = gpio_pin_get_dt(&m_buttons[id]);
	if (val < 0) {
		return -1;			// Error reading GPIO pin
	}
	*state = (val == 0) ? BUTTON_STATE_PRESSED : BUTTON_STATE_RELEASED;
	return 0;
}

/**
 * @brief		Get the state of all buttons as a bitmask
 * @param[out]	pressed_mask	Bitmask indicating which buttons are pressed (1 = pressed, 0 = released)
 * @return		0			success
 * 				negative	error code on failure
 */
int button_get_mask(uint32_t *pressed_mask)
{
	if (pressed_mask == NULL) {
		return -1;			// Invalid argument
	}

	uint32_t mask = 0;
	for (size_t i = 0; i < BUTTON_ID_COUNT; i++) {
		int val = gpio_pin_get_dt(&m_buttons[i]);
		if (val < 0) {
			return -1;		// Error reading GPIO pin
		}
		if (val == 0) {		// Button is pressed
			mask |= (1 << i);
		}
	}
	*pressed_mask = mask;
	return 0;
}

/**
 * @brief		Register a callback function for button events
 * @param[in]	id			Button identifier
 * @param[in]	callback	Callback function to be called on button events
 * @return		0			success
 * 				negative	error code on failure
 */
int button_register_callback(BUTTON_ID id, button_callback_t callback)
{
	if (id >= BUTTON_ID_COUNT) {
		return -1;			// Invalid button ID
	}
	if( callback == NULL) {
		return -1;			// Invalid callback
	}
	if( m_button_contexts[id].callback != NULL) {
		return -1;			// Callback already registered for this button
	}
	m_button_contexts[id].callback = callback;
	return 0;
}

/**
 * @brief		Unregister the callback function for a button
 * @param[in]	id			Button identifier
 * @return		0			success
 * 				negative	error code on failure
 */
int button_unregister_callback(BUTTON_ID id)
{
	if (id >= BUTTON_ID_COUNT) {
		return -1;			// Invalid button ID
	}
	m_button_contexts[id].callback = NULL;
	return 0;
}

/* Private user code ---------------------------------------------------------*/
/**
 * @brief		GPIO interrupt service routine for button presses
 * @param[in]	dev			Device that triggered the interrupt
 * @param[in]	cb			GPIO callback structure
 * @param[in]	pins		Bitmask of pins that triggered the interrupt
 */
static void button_gpio_isr(const struct device *dev, struct gpio_callback *cb, uint32_t pins)
{
	// Identify which button triggered the interrupt
	for (size_t i = 0; i < BUTTON_ID_COUNT; i++) {
		if (pins & BIT(m_buttons[i].pin)) {
			// Schedule debounce work for the corresponding button context
				k_work_reschedule(&m_button_contexts[i].debounce_work, K_MSEC(BUTTON_DEBOUNE_MS));
			break;
		}
	}
}

/**
 * @brief		Debounce work handler to determine stable button state and trigger events
 * @param[in]	work		Work item for debouncing
 */
static void button_debounce_work_handler(struct k_work *work)
{
	struct k_work_delayable *dwork = k_work_delayable_from_work(work);

	// Identify which button context is associated with the debounce work
	for (size_t i = 0; i < BUTTON_ID_COUNT; i++) {
		if (&m_button_contexts[i].debounce_work == dwork) {
			// Read the current state of the button GPIO pin
			int val = gpio_pin_get_dt(&m_buttons[i]);
			BUTTON_STATE current_state = (val == 0) ? BUTTON_STATE_PRESSED : BUTTON_STATE_RELEASED;

			// Check if the state has changed from the stable state
			if (current_state != m_button_contexts[i].stable_state) {
				// Update the stable state
				m_button_contexts[i].stable_state = current_state;

				// If a callback is registered, call it with the button ID and event type
				if (m_button_contexts[i].callback) {
					BUTTON_EVENT event = (current_state == BUTTON_STATE_PRESSED) ? BUTTON_EVENT_PRESSED : BUTTON_EVENT_RELEASED;
					m_button_contexts[i].callback(i, event);
				}
			}
			break;
		}
	}
}
```

## src/button.h
```c
/**
******************************************************************************
* @file				: button.h
* @brief			: Header for button.c file.
******************************************************************************
* @attention
*
* Copyright (c) 2026 hayaya inc.
* All rights reserved.
*
* This software is licensed under terms that can be found in the LICENSE file
* in the root directory of this software component.
* If no LICENSE file comes with this software, it is provided AS-IS.
*
******************************************************************************
*/

/* Define to prevent recursive inclusion -------------------------------------*/
#ifndef BUTTON_H
#define BUTTON_H


#ifdef __cplusplus
extern "C" {
#endif

/* Includes ------------------------------------------------------------------*/
#include <stdint.h>

/* Private includes ----------------------------------------------------------*/

/* Private defines -----------------------------------------------------------*/

/* Exported constants --------------------------------------------------------*/

/* Exported macro ------------------------------------------------------------*/

/* Exported types ------------------------------------------------------------*/
/**
 * @brief Button identifiers
 */
typedef enum __BUTTON_ID {
	BUTTON_ID_0,		// on-board button-1
	BUTTON_ID_1,		// on-board button-2
	BUTTON_ID_2,		// on-board button-3
	BUTTON_ID_3,		// on-board button-4
	BUTTON_ID_COUNT		// number of on-board buttons
} BUTTON_ID;

/**
 * @brief Button states
 */
typedef enum __BUTTON_STATE {
	BUTTON_STATE_RELEASED,		// Button is released
	BUTTON_STATE_PRESSED,		// Button is pressed
} BUTTON_STATE;

/**
 * @brief Button events
 */
typedef enum __BUTTON_EVENT {
	BUTTON_EVENT_NONE,			// No event
	BUTTON_EVENT_PRESSED,		// Button was pressed
	BUTTON_EVENT_RELEASED,		// Button was released
} BUTTON_EVENT;

/* Exported functions prototypes ---------------------------------------------*/
typedef void (*button_callback_t)(BUTTON_ID id, BUTTON_EVENT event);
int button_init(void);
int button_get(BUTTON_ID id, BUTTON_STATE *state);
int button_get_mask(uint32_t *pressed_mask);
int button_register_callback(BUTTON_ID id, button_callback_t callback);
int button_unregister_callback(BUTTON_ID id);

#ifdef __cplusplus
}
#endif

#endif  // BUTTON_H
```

## src/led.c
```c
/**
******************************************************************************
* @file				: led.c
* @brief			: LED driver.
******************************************************************************
* @attention
*
* Copyright (c) 2026 hayaya inc.
* All rights reserved.
*
* This software is licensed under terms that can be found in the LICENSE file
* in the root directory of this software component.
* If no LICENSE file comes with this software, it is provided AS-IS.
*
******************************************************************************
*/
/* Includes ------------------------------------------------------------------*/
#include <zephyr/drivers/gpio.h>

/* Private includes ----------------------------------------------------------*/
#include "led.h"

/* Private define ------------------------------------------------------------*/
#define LED0_NODE DT_ALIAS(led0)
#define LED1_NODE DT_ALIAS(led1)
#define LED2_NODE DT_ALIAS(led2)
#define LED3_NODE DT_ALIAS(led3)

/* Private typedef -----------------------------------------------------------*/
/**
 * @brief LED context structure for blinking functionality
 */
typedef struct __LED_CONTEXT {
	struct k_work_delayable blink_work;		// Delayed work for blinking
	uint32_t on_time_ms;					// On time in milliseconds
	uint32_t off_time_ms;					// Off time in milliseconds
	bool is_on;								// Current state of the LED
	bool is_blinking;						// Flag indicating if blinking is active
} LED_CONTEXT;

/* Private macro -------------------------------------------------------------*/

/* Private variables ---------------------------------------------------------*/
/**
 * @brief GPIO specifications for each LED, obtained from device tree
 */
static const struct gpio_dt_spec m_leds[] = {
	GPIO_DT_SPEC_GET(LED0_NODE, gpios),
	GPIO_DT_SPEC_GET(LED1_NODE, gpios),
	GPIO_DT_SPEC_GET(LED2_NODE, gpios),
	GPIO_DT_SPEC_GET(LED3_NODE, gpios),
};

/**
 * @brief LED contexts for each LED, used for blinking functionality
 */
static LED_CONTEXT m_led_contexts[LED_ID_COUNT];

/* Private function prototypes -----------------------------------------------*/
static void led_blink_work_handler(struct k_work *work);

/* External variables --------------------------------------------------------*/

/* Exported functions --------------------------------------------------------*/
/**
 * @brief		Initialize the LEDs
 * @return		0			success
 * 				negative	error code on failure
 */
int led_init(void)
{
	for (size_t i = 0; i < LED_ID_COUNT; i++) {
		if (!device_is_ready(m_leds[i].port)) {
			return -1;
		}
		int ret = gpio_pin_configure_dt(&m_leds[i], GPIO_OUTPUT_INACTIVE);
		if (ret < 0) {
			return -1;
		}
		k_work_init_delayable(&m_led_contexts[i].blink_work, led_blink_work_handler);
		m_led_contexts[i].is_on = false;
		m_led_contexts[i].is_blinking = false;
	}
	return 0;
}

/**
 * @brief		Set the state of an LED
 * @param[in]	id			LED identifier
 * @param[in]	state		Desired LED state
 * @return		0			success
 * 				negative	error code on failure
 */
int led_set(LED_ID id, LED_STATE state)
{
	int ret;

	if (id >= LED_ID_COUNT) {
		return -1;			// Invalid LED ID
	}

	ret = gpio_pin_set_dt(&m_leds[id], state == LED_STATE_ON ? 1 : 0);
	if (ret == 0) {
		m_led_contexts[id].is_on = (state == LED_STATE_ON);
	}
	return ret;
}

/**
 * @brief		Get the state of an LED
 * @param[in]	id			LED identifier
 * @param[out]	state		Current LED state
 * @return		0			success
 * 				negative	error code on failure
 */
int led_get(LED_ID id, LED_STATE *state)
{
	if (id >= LED_ID_COUNT || state == NULL) {
		return -1;			// Invalid argument
	}

	*state = m_led_contexts[id].is_on ? LED_STATE_ON : LED_STATE_OFF;
	return 0;
}

/**
 * @brief		Toggle the state of an LED
 * @param[in]	id			LED identifier
 * @return		0			success
 * 				negative	error code on failure
 */
int led_toggle(LED_ID id)
{
	int ret;

	if (id >= LED_ID_COUNT) {
		return -1;			// Invalid LED ID
	}

	ret = gpio_pin_toggle_dt(&m_leds[id]);
	if (ret == 0) {
		m_led_contexts[id].is_on = !m_led_contexts[id].is_on;
	}
	return ret;
}

/**
 * @brief		Set the state of multiple LEDs using a bitmask
 * @param[in]	on_mask		Bitmask indicating which LEDs to turn on (1 = on, 0 = off)
 * @return		0			success
 * 				negative	error code on failure
 */
int led_set_mask( uint32_t on_mask)
{
	for (size_t i = 0; i < LED_ID_COUNT; i++) {
		LED_STATE state = (on_mask & (1 << i)) ? LED_STATE_ON : LED_STATE_OFF;
		int ret = led_set(i, state);
		if (ret < 0) {
			return -1;		// Error setting LED state
		}
	}
	return 0;
}

/**
 * @brief		Toggle the state of multiple LEDs using a bitmask
 * @param[in]	toggle_mask		Bitmask indicating which LEDs to toggle (1 = toggle, 0 = no change)
 * @return		0			success
 * 				negative	error code on failure
 */
int led_toggle_mask( uint32_t toggle_mask)
{
	for (size_t i = 0; i < LED_ID_COUNT; i++) {
		if (toggle_mask & (1 << i)) {
			int ret = led_toggle(i);
			if (ret < 0) {
				return -1;	// Error toggling LED state
			}
		}
	}
	return 0;
}

/**
 * @brief		Start blinking an LED with specified on/off times
 * @param[in]	id				LED identifier
 * @param[in]	on_time_ms		On time in milliseconds
 * @param[in]	off_time_ms		Off time in milliseconds
 * @return		0				success
 * 				negative		error code on failure
 */
int led_blink_start( LED_ID id, uint32_t on_time_ms, uint32_t off_time_ms)
{
	if (id >= LED_ID_COUNT) {
		return -1;			// Invalid LED ID
	}
	m_led_contexts[id].on_time_ms = on_time_ms;
	m_led_contexts[id].off_time_ms = off_time_ms;
	m_led_contexts[id].is_blinking = true;
	led_set(id, LED_STATE_ON);
	k_work_reschedule(&m_led_contexts[id].blink_work, K_MSEC(on_time_ms));
	return 0;
}

/**
 * @brief		Stop blinking an LED
 * @param[in]	id			LED identifier
 * @return		0			success
 * 				negative	error code on failure
 */
int led_blink_stop( LED_ID id)
{
	if (id >= LED_ID_COUNT) {
		return -1;			// Invalid LED ID
	}

	// Stop blinking and reset LED state to off
	m_led_contexts[id].is_blinking = false;
	k_work_cancel_delayable(&m_led_contexts[id].blink_work);
	m_led_contexts[id].is_on = false;
	return led_set(id, LED_STATE_OFF);
}

/**
 * @brief		Toggle blinking state of an LED (start if stopped, stop if started)
 * @param[in]	id				LED identifier
 * @param[in]	on_time_ms		On time in milliseconds (used if starting blinking)
 * @param[in]	off_time_ms		Off time in milliseconds (used if starting blinking)
 * @return		0				success
 * 				negative		error code on failure
 */
int led_blink_toggle( LED_ID id, uint32_t on_time_ms, uint32_t off_time_ms)
{
	if (id >= LED_ID_COUNT) {
		return -1;			// Invalid LED ID
	}
	if (m_led_contexts[id].is_blinking) {
		return led_blink_stop(id);
	} else {
		return led_blink_start(id, on_time_ms, off_time_ms);
	}
}


/* Private user code ---------------------------------------------------------*/
/**
 * @brief		Work handler for LED blinking functionality
 * @param[in]	work		Work item for blinking
 */
static void led_blink_work_handler(struct k_work *work)
{
	struct k_work_delayable *dwork = k_work_delayable_from_work(work);

	for( size_t i = 0; i < LED_ID_COUNT; i++) {
		if (&m_led_contexts[i].blink_work == dwork) {
			if (m_led_contexts[i].is_blinking) {
				// Toggle LED state
				led_set(i, m_led_contexts[i].is_on ? LED_STATE_OFF : LED_STATE_ON);

				// Reschedule work for the next toggle
				uint32_t delay_ms = m_led_contexts[i].is_on ? m_led_contexts[i].on_time_ms : m_led_contexts[i].off_time_ms;
				k_work_reschedule(&m_led_contexts[i].blink_work, K_MSEC(delay_ms));
			}
		}
	}
}
```

## src/led.h
```c
/**
******************************************************************************
* @file				: led.h
* @brief			: Header for led.c file.
******************************************************************************
* @attention
*
* Copyright (c) 2026 hayaya inc.
* All rights reserved.
*
* This software is licensed under terms that can be found in the LICENSE file
* in the root directory of this software component.
* If no LICENSE file comes with this software, it is provided AS-IS.
*
******************************************************************************
*/

/* Define to prevent recursive inclusion -------------------------------------*/
#ifndef LED_H
#define LED_H


#ifdef __cplusplus
extern "C" {
#endif

/* Includes ------------------------------------------------------------------*/
#include <stdint.h>

/* Private includes ----------------------------------------------------------*/

/* Private defines -----------------------------------------------------------*/

/* Exported constants --------------------------------------------------------*/

/* Exported macro ------------------------------------------------------------*/

/* Exported types ------------------------------------------------------------*/
/**
 * @brief LED identifiers
 */
typedef enum __LED_ID {
	LED_ID_0,			// on-board LED-1
	LED_ID_1,			// on-board LED-2
	LED_ID_2,			// on-board LED-3
	LED_ID_3,			// on-board LED-4
	LED_ID_COUNT,		// number of on-board LEDs
} LED_ID;

/**
 * @brief LED states
 */
typedef enum __LED_STATE {
	LED_STATE_OFF,  	// LED is off
	LED_STATE_ON,		// LED is on
} LED_STATE;

/* Exported functions prototypes ---------------------------------------------*/
int led_init(void);
int led_set(LED_ID id, LED_STATE state);
int led_get(LED_ID id, LED_STATE *state);
int led_toggle(LED_ID id);
int led_set_mask( uint32_t on_mask);
int led_toggle_mask( uint32_t toggle_mask);
int led_blink_start( LED_ID id, uint32_t on_time_ms, uint32_t off_time_ms);
int led_blink_stop( LED_ID id);
int led_blink_toggle( LED_ID id, uint32_t on_time_ms, uint32_t off_time_ms);

#ifdef __cplusplus
}
#endif

#endif  // LED_H
```

## src/nus.c
```c
/**
******************************************************************************
* @file				: nus.c
* @brief			: Nordic UART Service notifications.
******************************************************************************
*/
/* Includes ------------------------------------------------------------------*/
#include <errno.h>
#include <stdio.h>
#include <stdlib.h>
#include <string.h>
#include <ctype.h>
#include <zephyr/kernel.h>
#include <zephyr/bluetooth/bluetooth.h>
#include <zephyr/bluetooth/conn.h>
#include <zephyr/bluetooth/uuid.h>
#include <bluetooth/services/nus.h>

/* Private includes ----------------------------------------------------------*/
#include "nus.h"

/* Private define ------------------------------------------------------------*/
#define LED_STATE_MSG_SIZE			20		// Keep messages within the default BLE notification payload

/* Private variables ---------------------------------------------------------*/
/**
 * @brief		Current BLE connection, or NULL if not connected
 */
static struct bt_conn *m_current_conn;

/**
 * @brief		Whether the connected peer has enabled notifications for the NUS TX characteristic
 */
static bool m_notify_enabled;
static struct k_work_delayable m_notify_work;
static bool m_pending_led_event;			// Whether there is a pending LED event to notify (as opposed to a pending periodic state notification)
static LED_ID m_pending_led_id;				// If there is a pending LED event, the ID of the LED that changed
static uint32_t m_notify_count;
static nus_led_control_callback_t m_led_control_callback = NULL;	// Registered callback for controlling LEDs from BLE commands

/**
 * @brief		BLE advertising data and scan response data
 */
static const struct bt_data m_ad[] = {
	BT_DATA_BYTES(BT_DATA_FLAGS, (BT_LE_AD_GENERAL | BT_LE_AD_NO_BREDR)),	// General discoverable mode, BR/EDR not supported
	BT_DATA_BYTES(BT_DATA_UUID128_ALL, BT_UUID_NUS_VAL),					// Advertise NUS service UUID
};

/**
 * @brief		BLE advertising data and scan response data
 */
static const struct bt_data m_sd[] = {
	BT_DATA(BT_DATA_NAME_COMPLETE, CONFIG_BT_DEVICE_NAME, sizeof(CONFIG_BT_DEVICE_NAME) - 1),	// Complete device name
};

/* Private function prototypes -----------------------------------------------*/
static void connected(struct bt_conn *conn, uint8_t err);
static void disconnected(struct bt_conn *conn, uint8_t reason);
static void nus_received(struct bt_conn *conn, const uint8_t *const data, uint16_t len);
static void nus_send_enabled(enum bt_nus_send_status status);
static void notify_work_handler(struct k_work *work);
static void notify_schedule(void);
static int advertising_start(void);
static int led_state_message(char *buf, size_t buf_size);
static int led_state_mask(uint32_t *mask);

/**
 * @brief		BLE connection callbacks structure
 */
BT_CONN_CB_DEFINE(conn_callbacks) = {
	.connected = connected,
	.disconnected = disconnected,
};

/* Exported functions --------------------------------------------------------*/
/**
 * @brief		Initialize Bluetooth LE and Nordic UART Service
 * @return		0			success
 * 				negative	error code on failure
 */
int nus_init(void)
{
	int ret;
	static struct bt_nus_cb nus_cb = {
		.received = nus_received,
		.send_enabled = nus_send_enabled,
	};

	k_work_init_delayable(&m_notify_work, notify_work_handler);

	// Initialize Bluetooth subsystem
	ret = bt_enable(NULL);
	if (ret < 0) {
		return ret;
	}

	// Initialize Nordic UART Service with callbacks
	ret = bt_nus_init(&nus_cb);
	if (ret < 0) {
		return ret;
	}

	return advertising_start();
}

/**
 * @brief		Return whether a BLE peer is connected
 */
bool nus_is_connected(void)
{
	return m_current_conn != NULL;
}

/**
 * @brief		Notify the connected peer of all LED states
 * @return		0			success or skipped because no peer subscribes
 * 				negative	error code on failure
 */
int nus_notify_led_state(void)
{
	m_pending_led_event = false;
	notify_schedule();
	return 0;
}

/**
 * @brief		Notify the connected peer of the LED event and all LED states
 * @param[in]	id			LED identifier that changed
 * @return		0			success or skipped because no peer subscribes
 * 				negative	error code on failure
 */
int nus_notify_led_event(LED_ID id)
{
	if (id >= LED_ID_COUNT) {
		return -EINVAL;
	}

	m_pending_led_event = true;
	m_pending_led_id = id;
	notify_schedule();
	return 0;
}

/**
 * @brief		Register a callback function for controlling LEDs from BLE commands
 * @param[in]	callback	Callback function to register
 * @return		0			success
 * 				negative	error code on failure (e.g., invalid argument, callback already registered)
 */
int nus_register_led_control_callback(nus_led_control_callback_t callback)
{
	if (callback == NULL) {
		return -EINVAL;
	}
	if (m_led_control_callback != NULL) {
		return -EBUSY;		// A callback is already registered
	}

	m_led_control_callback = callback;
	return 0;
}

/**
 * @brief		Unregister the callback function for controlling LEDs from BLE commands
 * @return		0			success
 * 				negative	error code on failure (e.g., no callback registered)
 */
int nus_unregister_led_control_callback(void)
{
	m_led_control_callback = NULL;
	return 0;
}

/* Private user code ---------------------------------------------------------*/
/**
 * @brief		BLE connection callback for when a connection is established
 * @param[in]	conn  Pointer to connection object that has been established
 * @param[in]	err   Connection error code (0 if successful)
 */
static void connected(struct bt_conn *conn, uint8_t err)
{
	if (err != 0) {
		printf("BLE connection failed (err %u)\n", err);
		return;
	}

	m_current_conn = bt_conn_ref(conn);
	printf("BLE connected\n");
	(void)nus_notify_led_state();
}

/**
 * @brief		BLE connection callback for when a connection is disconnected
 * @param[in]	conn   Pointer to connection object that has been disconnected
 * @param[in]	reason Disconnection reason code
 */
static void disconnected(struct bt_conn *conn, uint8_t reason)
{
	printf("BLE disconnected (reason %u)\n", reason);

	if (m_current_conn != NULL) {
		bt_conn_unref(m_current_conn);
		m_current_conn = NULL;
	}
	m_notify_enabled = false;

	(void)advertising_start();
}

/**
 * @brief		BLE callback for when data is received on the NUS RX characteristic
 * @param[in]	conn  Pointer to connection object from which data was received
 * @param[in]	data  Pointer to received data buffer
 * @param[in]	len   Length of received data in bytes
 */
static void nus_received(struct bt_conn *conn, const uint8_t *const data, uint16_t len)
{
	uint32_t mask;

	ARG_UNUSED(conn);

	if( isxdigit((unsigned char)data[0]) != 0) {
		mask = strtoul((const char *)data, NULL, 16);
		if (m_led_control_callback != NULL) {
			m_led_control_callback(mask);
		}
	}
	printf("NUS RX: %.*s\n", len, data);
}

/**
 * @brief		BLE callback for when notification status changes
 * @param[in]	status Notification status
 */
static void nus_send_enabled(enum bt_nus_send_status status)
{
	m_notify_enabled = (status == BT_NUS_SEND_STATUS_ENABLED);
	printf("NUS notifications %s\n", m_notify_enabled ? "enabled" : "disabled");

	if (m_notify_enabled) {
		(void)nus_notify_led_state();
	}
}

/**
 * @brief		Work handler that sends the latest LED state over NUS
 * @param[in]	work Work item
 */
static void notify_work_handler(struct k_work *work)
{
	char msg[LED_STATE_MSG_SIZE];
	int len;
	int pos;

	ARG_UNUSED(work);

	if (!m_notify_enabled) {
		return;
	}

	m_notify_count++;

	if (m_pending_led_event) {
		pos = snprintf(msg, sizeof(msg), "B%u ",
			       (unsigned int)m_pending_led_id);
	} else {
		pos = snprintf(msg, sizeof(msg), "N%u ",
			       (unsigned int)m_notify_count);
	}

	if (pos < 0 || pos >= sizeof(msg)) {
		return;
	}

	len = led_state_message(&msg[pos], sizeof(msg) - pos);
	if (len < 0) {
		return;
	}

	(void)bt_nus_send(NULL, (const uint8_t *)msg, pos + len);
}

/**
 * @brief		Schedule a NUS notification after CCC state has settled
 */
static void notify_schedule(void)
{
	k_work_reschedule(&m_notify_work, K_MSEC(50));
}

/**
 * @brief		Start BLE advertising with predefined parameters and data
 * @return		0			success
 * 				negative	error code on failure
 */
static int advertising_start(void)
{
	int ret;

	ret = bt_le_adv_start(BT_LE_ADV_CONN_FAST_1, m_ad, ARRAY_SIZE(m_ad), m_sd, ARRAY_SIZE(m_sd));
	if (ret < 0 && ret != -EALREADY) {
		printf("BLE advertising failed (err %d)\n", ret);
		return ret;
	}

	printf("BLE advertising as %s\n", CONFIG_BT_DEVICE_NAME);
	return 0;
}

/**
 * @brief		Construct a message containing the state of all LEDs
 * @param[out]	buf			Buffer to write the message into
 * @param[in]	buf_size	Size of the buffer in bytes
 * @return		Number of bytes written to the buffer on success
 * 				negative	error code on failure
 */
static int led_state_message(char *buf, size_t buf_size)
{
	uint32_t mask;
	int ret;

	ret = led_state_mask(&mask);
	if (ret < 0) {
		return ret;
	}

	ret = snprintf(buf, buf_size, "L=%X\n", (unsigned int)mask);
	if (ret < 0 || ret >= buf_size) {
		return -ENOMEM;
	}

	return ret;
}

static int led_state_mask(uint32_t *mask)
{
	uint32_t value = 0;

	for (size_t i = 0; i < LED_ID_COUNT; i++) {
		LED_STATE state;
		int ret = led_get((LED_ID)i, &state);

		if (ret < 0) {
			return ret;
		}

		if (state == LED_STATE_ON) {
			value |= BIT(i);
		}
	}

	*mask = value;
	return 0;
}
```

## src/nus.h
```c
/**
******************************************************************************
* @file				: nus.h
* @brief			: Header for Nordic UART Service notifications.
******************************************************************************
*/

/* Define to prevent recursive inclusion -------------------------------------*/
#ifndef NUS_H
#define NUS_H

#ifdef __cplusplus
extern "C" {
#endif

/* Includes ------------------------------------------------------------------*/
#include <stdbool.h>

#include "led.h"

/* Exported functions prototypes ---------------------------------------------*/
typedef void (*nus_led_control_callback_t)(uint32_t led_mask);
int nus_init(void);
bool nus_is_connected(void);
int nus_notify_led_state(void);
int nus_notify_led_event(LED_ID id);
int nus_register_led_control_callback(nus_led_control_callback_t callback);
int nus_unregister_led_control_callback(void);

#ifdef __cplusplus
}
#endif

#endif  // NUS_H
```
